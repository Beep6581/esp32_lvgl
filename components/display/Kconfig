## components/display/Kconfig
```kconfig
menu "Display"

config DISPLAY_DIAGNOSTIC_BITWALK
    bool "Run low-level bitwalk diagnostic"
    depends on APP_MODE_SCREEN_DIAGNOSTICS
    default n
    help
        Draw a direct RGB data-bit test without starting LVGL.

endmenu
```

## components/ui/Kconfig
```kconfig
menu "UI"

config UI_METRICS
    bool "Log screen-diagnostic animation metrics once per second"
    default n
    help
        Logs animation callbacks and LVGL refresh, render, and flush metrics
        once per second for the active screen-diagnostic page.

endmenu
```

## main/Kconfig.projbuild
```kconfig
menu "Application"

choice APP_MODE
    prompt "Application mode"
    default APP_MODE_AIR_QUALITY

config APP_MODE_AIR_QUALITY
    bool "Air-quality monitor"

config APP_MODE_SCREEN_DIAGNOSTICS
    bool "Screen diagnostics"

config APP_MODE_CLOCK
    bool "Particle clock"
    select LV_FONT_MONTSERRAT_48

endchoice

endmenu
```
